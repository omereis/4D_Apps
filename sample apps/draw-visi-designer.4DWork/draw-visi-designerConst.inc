// File generated 21/02/2022 11:00:04
// Warning! This is a generated file, any manual changes will be
// lost during the next generation.

#constant  IFONT_OFFSET     0
// object indexes into ImageControl
#CONST
    iUserled1       // offset 0x0
    iUserled2       // offset 0x2800
    iUserled3       // offset 0x5000
    iUserled4       // offset 0x7800
    iUserled5       // offset 0xA000
    iUserled6       // offset 0xC000
    iUserled7       // offset 0xE000
    iUserled8       // offset 0x10000
    iUserled9       // offset 0x12000
    iUserled10      // offset 0x14000
    iStatictext1    // offset 0x16000
    iStatictext2    // offset 0x16600
    iStatictext3    // offset 0x16C00
    iStatictext4    // offset 0x17200
    iStatictext5    // offset 0x17800
    iStatictext6    // offset 0x17E00
    iImage1         // offset 0x18400
#END


#IFNOT EXISTS NOGLOBALS
var hndl ;
#ENDIF
